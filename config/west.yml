## config/west.yml
```yaml
manifest:
  remotes:
    - name: zmkfirmware
      url-base: github.com/zmkfirmware
  projects:
    - name: zmk
      remote: zmkfirmware
      revision: main
      import: app/west.yml
  self:
    path: config
```
